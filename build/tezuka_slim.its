## build/tezuka_slim.its
```
/dts-v1/;
/ {
	description = "Nano zero-copy appliance (slim, USB dr_mode=peripheral): DMABUF kernel + iiod + zcd, flashable: flash read-only, S50maia/S20jffs2 disabled";
	magic = "ITB PlutoSDR (ADALM-PLUTO)";
	#address-cells = <1>;
	images {
		fdt@1 { description = "zynq-pluto-sdr"; data = /incbin/("fdt_slim.dtb"); type = "flat_dt"; arch = "arm"; compression = "none"; };
		fpga@1 { description = "FPGA"; data = /incbin/("img1.bin"); type = "fpga"; compatible = "u-boot,fpga-legacy"; arch = "arm"; compression = "none"; load = <0x0f000000>; hash@1 { algo = "md5"; }; };
		linux_kernel@1 { description = "Linux"; data = /incbin/("kernel_zc2.gz"); type = "kernel"; arch = "arm"; os = "linux"; compression = "gzip"; load = <0x8000>; entry = <0x8000>; hash@1 { algo = "md5"; }; };
		ramdisk@1 { description = "Ramdisk"; data = /incbin/("slim_ramdisk.xz"); type = "ramdisk"; arch = "arm"; os = "linux"; compression = "none"; hash@1 { algo = "md5"; }; };
	};
	configurations {
		default = "config@0";
		config@0 {
			description = "Linux with fpga (nano-sdr patched: flash read-only)";
			fdt = "fdt@1";
			kernel = "linux_kernel@1";
			ramdisk = "ramdisk@1";
			fpga = "fpga@1";
		};
		config@1 {
			description = "Linux with fpga (nano-sdr patched: flash read-only)";
			fdt = "fdt@1";
			kernel = "linux_kernel@1";
			ramdisk = "ramdisk@1";
			fpga = "fpga@1";
		};
		config@2 {
			description = "Linux with fpga (nano-sdr patched: flash read-only)";
			fdt = "fdt@1";
			kernel = "linux_kernel@1";
			ramdisk = "ramdisk@1";
			fpga = "fpga@1";
		};
		config@3 {
			description = "Linux with fpga (nano-sdr patched: flash read-only)";
			fdt = "fdt@1";
			kernel = "linux_kernel@1";
			ramdisk = "ramdisk@1";
			fpga = "fpga@1";
		};
		config@4 {
			description = "Linux with fpga (nano-sdr patched: flash read-only)";
			fdt = "fdt@1";
			kernel = "linux_kernel@1";
			ramdisk = "ramdisk@1";
			fpga = "fpga@1";
		};
		config@5 {
			description = "Linux with fpga (nano-sdr patched: flash read-only)";
			fdt = "fdt@1";
			kernel = "linux_kernel@1";
			ramdisk = "ramdisk@1";
			fpga = "fpga@1";
		};
		config@6 {
			description = "Linux with fpga (nano-sdr patched: flash read-only)";
			fdt = "fdt@1";
			kernel = "linux_kernel@1";
			ramdisk = "ramdisk@1";
			fpga = "fpga@1";
		};
		config@7 {
			description = "Linux with fpga (nano-sdr patched: flash read-only)";
			fdt = "fdt@1";
			kernel = "linux_kernel@1";
			ramdisk = "ramdisk@1";
			fpga = "fpga@1";
		};
		config@8 {
			description = "Linux with fpga (nano-sdr patched: flash read-only)";
			fdt = "fdt@1";
			kernel = "linux_kernel@1";
			ramdisk = "ramdisk@1";
			fpga = "fpga@1";
		};
		config@9 {
			description = "Linux with fpga (nano-sdr patched: flash read-only)";
			fdt = "fdt@1";
			kernel = "linux_kernel@1";
			ramdisk = "ramdisk@1";
			fpga = "fpga@1";
		};
		config@10 {
			description = "Linux with fpga (nano-sdr patched: flash read-only)";
			fdt = "fdt@1";
			kernel = "linux_kernel@1";
			ramdisk = "ramdisk@1";
			fpga = "fpga@1";
		};
	};
};
```
